//
//  SignalBuffer.cpp
//  AirSense Firmware
//
//  DSP V4.1
//

#include "SignalBuffer.h"

////////////////////////////////////////////////////////
// Singleton
////////////////////////////////////////////////////////

SignalBuffer&
SignalBuffer::shared()
{
    static SignalBuffer instance;

    return instance;
}

////////////////////////////////////////////////////////
// Constructor
////////////////////////////////////////////////////////

SignalBuffer::SignalBuffer()
{
    clear();
}

////////////////////////////////////////////////////////
// Clear
////////////////////////////////////////////////////////

void SignalBuffer::clear()
{
    _count = 0;

    for (uint16_t i = 0; i < DSPConfig::FFT_SIZE; i++)
    {
        _raw[i] = 0.0f;

        _working[i] = 0.0f;

        _fft[i] = 0.0f;
    }
}

////////////////////////////////////////////////////////
// Update Raw Signal
////////////////////////////////////////////////////////

void SignalBuffer::update(
    const float* samples,
    uint16_t count
)
{
    if (samples == nullptr)
    {
        return;
    }

    if (count > DSPConfig::FFT_SIZE)
    {
        count = DSPConfig::FFT_SIZE;
    }

    _count = count;

    for (uint16_t i = 0; i < count; i++)
    {
        _raw[i] = samples[i];
    }
}

////////////////////////////////////////////////////////
// Copy Raw -> Working
////////////////////////////////////////////////////////

void SignalBuffer::copyRawToWorking()
{
    for (uint16_t i = 0; i < _count; i++)
    {
        _working[i] = _raw[i];
    }
}

////////////////////////////////////////////////////////
// Copy Working -> FFT
////////////////////////////////////////////////////////

void SignalBuffer::copyWorkingToFFT()
{
    for (uint16_t i = 0; i < _count; i++)
    {
        _fft[i] = _working[i];
    }
}

////////////////////////////////////////////////////////
// Raw Samples
////////////////////////////////////////////////////////

const float*
SignalBuffer::rawSamples() const
{
    return _raw;
}

////////////////////////////////////////////////////////
// Working Samples
////////////////////////////////////////////////////////

float*
SignalBuffer::workingSamples()
{
    return _working;
}

////////////////////////////////////////////////////////
// FFT Samples
////////////////////////////////////////////////////////

float*
SignalBuffer::fftSamples()
{
    return _fft;
}

////////////////////////////////////////////////////////
// Sample Count
////////////////////////////////////////////////////////

uint16_t
SignalBuffer::sampleCount() const
{
    return _count;
}

////////////////////////////////////////////////////////
// Capacity
////////////////////////////////////////////////////////

uint16_t
SignalBuffer::capacity() const
{
    return DSPConfig::FFT_SIZE;
}